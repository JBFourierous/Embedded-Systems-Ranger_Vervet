/*
 * classifier.c
 *
 *  Created on: 27 lug 2019
 *      Author: JBFourierous
 */

#include "classifier.h"

uint8_t long_classification_time = 0;		// counter of classification procedures that lasted more than 700ms

// Tap weights of FIR filters obtained training an LMS adaptive filter to minimize the estimation error of an input sequence with respect
// to a training set of signals
const float32_t w_lms_eagle[] = {0.0046, 0.0066, -0.0067, 0.0016, 0.0063, -0.0084, -0.0060, 0.0029, -0.0046, -0.0020};

const float32_t w_lms_leo[] = {0.0196, -0.0319, 0.0191, -0.0184, 0.0116, 0.0131, -0.0083, 0.0216, -0.0243, -0.0039};

const float32_t w_lms_snk[] = {-0.0034, -0.0103, -0.0119, -0.0044, 0.0073,	0.0059, -0.0015, -0.0010, 0.0110, 0.0078};

// Tap weights of an FIR highpass filter with 0.1kHz stopband synthesized with equiripple algorithm
const float32_t highpass_filter[] = {-0.228740, -0.002314, -0.002321, -0.002329, -0.002347, -0.002357, -0.002374, -0.002379,
-0.002393, -0.002398, -0.002413, -0.002418, -0.002434, -0.002439, -0.002454, -0.002459,
-0.002475, -0.002480, -0.002497, -0.002501, -0.002519, -0.002523, -0.002541, -0.002545,
-0.002565, -0.002568, -0.002589, -0.002591, -0.002615, -0.002616, -0.002641, -0.002639,
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-0.002393, -0.002379, -0.002374, -0.002357, -0.002347, -0.002329, -0.002321, -0.002314,
-0.228740};


const float32_t eagle_df[] = {-0.000938, -0.000269, 0.000926, 0.000725, -0.000845, 0.004703, 0.002754, -0.003357,
-0.000870, 0.001281, -0.000518, -0.003184, 0.001192, 0.001872, -0.000565, -0.001138,
0.000713, -0.000635, -0.005099, 0.000214, 0.004291, -0.003700, -0.005306, 0.001425,
-0.001010, -0.000949, 0.000830, 0.000944, -0.002842, -0.000712, -0.000393, 0.004037,
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0.008629, 0.004636, -0.002888, -0.022653, -0.010678, -0.002991, 0.003572, 0.010999};


const float32_t leo_df[] = {0.000258, -0.000577, -0.000700, -0.001229, -0.000922, 0.000612, 0.000405, 0.000553,
0.000737, 0.000901, 0.001661, 0.000902, 0.000610, 0.000643, -0.000567, -0.002331,
-0.002310, -0.002212, -0.000914, -0.000426, -0.000430, 0.002003, 0.002554, 0.001961,
0.001615, 0.000570, -0.000892, -0.001440, -0.001547, -0.000605, -0.000861, -0.001410,
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-0.000389, 0.005540, 0.009839, 0.006874, 0.004004, -0.002363, -0.019448, -0.020467};


const float32_t snk_df[] = {-0.000359, 0.001378, -0.003391, -0.002526, 0.001830, -0.000482, 0.002634, 0.000041,
0.002017, 0.001315, 0.001082, 0.003314, 0.000870, 0.003137, 0.000517, 0.005344,
-0.002404, 0.001863, 0.001298, 0.000437, -0.000015, 0.003012, -0.004460, -0.000094,
-0.000107, -0.000762, 0.002859, 0.000059, 0.001345, 0.005871, -0.002190, 0.000075,
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-0.010599, 0.010793, -0.007052, -0.003620, -0.025167, -0.004669, -0.007866, -0.010776};


// ------------------------------------------------- INNER FUNCTIONS ----------------------------------------------------------------- //

/**
 * @brief  Swaps two input float values
 * @param  a      points to the first value
 * @param  b      points to the second value
 * @return none
 */
static void swap_float(float32_t* a, float32_t* b) {
	float32_t tmp;
	tmp = *b;
	*b = *a;
	*a = tmp;
}

/**
 * @brief  Swaps two input char values
 * @param  a      points to the first value
 * @param  b      points to the second value
 * @return none
 */
static void swap_char(char* a, char* b) {
	char tmp;
	tmp = *b;
	*b = *a;
	*a = tmp;
}

/**
 * @brief  FIR filtering of a sequence.
 * @param  input    points to the input sequence
 * @param  fir      points to the FIR tap weights
 * @param  fir_size FIR filter length
 * @return out      pointer to the filtered output
 */
static void filter(float32_t* input, const float32_t* fir, const uint16_t fir_size, float32_t* out) {
	arm_fir_instance_f32 S;
	float32_t fir_state[BLOCK_SIZE + fir_size -1];
	uint32_t block_size = BLOCK_SIZE;
	uint32_t num_blocks = INPUT_SIZE/BLOCK_SIZE;
	arm_fir_init_f32(&S, fir_size, fir, fir_state, block_size);
	for(int i=0; i < num_blocks; i++) {
		arm_fir_f32(&S, input+(i*block_size), out+(i*block_size), block_size);
	}
}

/**
 * @brief  Calculates the maximum of the correlation of two input sequences
 * @param  input  points to the first input sequence
 * @param  sample points to the second input sequence
 * @return max    maximum value of the correlation sequence
 */
static float32_t correlate(float32_t* input, const float32_t* sample) {
	float32_t max = -0.00001, xcorr = 0;
	bool backwards = false;
	int delay = 0, index = 0, limit = 0;
	for(delay = -INPUT_SIZE; delay < INPUT_SIZE; delay+=100) {
		if(delay < 0) {
			backwards = false;
			limit = INPUT_SIZE + delay;
		} else {
			backwards = true;
			limit = 5 - delay;
		}
		for(index = 0; index < limit; index++) {
			if(backwards) {
				xcorr = xcorr + input[index]*sample[delay+index];
			} else {
				xcorr = xcorr + input[-delay+index]*sample[index];
			}
		}
		if(xcorr > max)
			max = xcorr;
		xcorr = 0;
	}
	return max;
}

/** @brief  Filters an input sequence and evaluates its maximum correlation with a second input sequence after FIR filtering
 *  @param  input    pointer to the first input sequence
 *  @param  fir      pointer to the FIR tap weights
 *  @param  fir_size FIR filter length
 *  @param  out      pointer to the result of the FIR filtering
 *  @param  sample   pointer to the second input sequence
 *  @return maximum value of the correlation
 */
static float32_t filter_and_correlate(float32_t* input, const float32_t* fir, const uint16_t fir_size, float32_t* out, const float32_t* sample) {
	filter(input, fir, fir_size, out);
	return correlate(out, sample);
}

// ------------------------------------------------- END OF INNER FUNCTIONS ---------------------------------------------------------- //



// ----------------------------------------------- INTERFACE FUNCTIONS ------------------------------------------------------------- //

/**
 * @brief  Classifies the input signal according to 4 classes, selecting with a maximum correlation logic
 * @param  input      points to input sequence
 * @return identifier of the input class recognized by the algorithm
 */
char classify(float32_t* input) {
	char id[3] = {'e','l','s'};
	float32_t tmp[INPUT_SIZE];
	float32_t corrs[3];
	const uint16_t highpass_size = HIGHPASS_SIZE;
	const uint16_t lms_size = LMS_SIZE;
	uint32_t start = 0, end = 0;
	start = HAL_GetTick();
	// Highpass filtering of the input signal
	filter(input, highpass_filter, highpass_size, input);
	// LMS filtering of the input signal for the three classes and correlation calculation
	corrs[0] = filter_and_correlate(input, w_lms_eagle, lms_size, tmp, eagle_df);
	corrs[1] = filter_and_correlate(input, w_lms_leo, lms_size, tmp, leo_df);
	corrs[2] = filter_and_correlate(input, w_lms_snk, lms_size, tmp, snk_df);
	// Ascending order
	if(fabsf(corrs[0]) > fabsf(corrs[2])) {
		swap_float(&corrs[0], &corrs[2]);
		swap_char(&id[0], &id[2]);
	}
	if(fabsf(corrs[0]) > fabsf(corrs[1])) {
		swap_float(&corrs[0], &corrs[1]);
		swap_char(&id[0], &id[1]);
	}
	if(fabsf(corrs[1]) > fabsf(corrs[2])) {
		swap_float(&corrs[1], &corrs[2]);
		swap_char(&id[1], &id[2]);
	}
	end = HAL_GetTick();
	// increase long classifications counter
	if(end-start > 600)
		long_classification_time++;
	// return the id corresponding to the maximum correlation
	if(fabsf(corrs[2]) > fabsf(2*corrs[1]))
		return id[2];
	else
		return 'n';
}

// ------------------------------------------------ END OF INTERFACE FUNCTIONS -------------------------------------------------------- //


